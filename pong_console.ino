#include <Wire.h>
#include <Adafruit_GFX.h>
#include <Adafruit_SSD1306.h>

Adafruit_SSD1306 display(128, 64, &Wire, -1);


#define ball_delay  49
#define score_dsp_delay  2
#define menu_delay  399
#define pallet_delay 19


byte selY = 12;
boolean b1;
boolean b2;

//boolean up;
//boolean down;
//boolean left;
//boolean right;
//boolean a;
//boolean buttonB;
//byte aa;
//boolean bButton = 0;
byte location = 0;
unsigned long sec;

//pong vars
byte y = 32;
byte x = 64;
byte bx = 2;
byte by = 2;
byte p1_score = 0;
byte p2_score = 0;
byte p1_pallet_y = 32;
byte p2_pallet_y = 32;
byte players = 2;
byte goal;
byte dif = 3;
byte p1_score1 = 0;
byte p2_score2 = 0;
byte yscore = 15;
byte xscore1 = 40;
byte xscore2 = 68;
boolean needRand = 0;
boolean sound = 0;
unsigned long delai;


//stopwatch vars
unsigned long startTime;
bool stTimeB = 1;
unsigned long millisec;
byte seconds;
byte minutes;
byte hours;

void load(){
  display.setTextSize(1);
  display.setTextColor(WHITE);

  display.clearDisplay();
  display.setCursor(0, 0);
  display.println("> booted up");
  display.display();
  delay(1000);
  
  display.setCursor(0, 8);
  display.println("> initialazing system>");
  display.display();

  for(byte i = 0; i <= 5; i++){
    display.setCursor(6, 8*2);
    if(i % 2 == 0){
      display.setTextColor(WHITE);
    } else{
      display.setTextColor(BLACK);
    }
    display.print("_");
    display.display();
    delay(500);
  }

  display.setCursor(6, 8*2);
  display.setTextColor(WHITE);
  display.println("  done initialazing");
  display.display();
  delay(700);

  display.setCursor(0, 8*3);
  display.print("> starting execution >");
  display.display();

  for(byte i = 0; i <= 5; i++){
    display.setCursor(6, 8*4);
    if(i % 2 == 0){
      display.setTextColor(WHITE);
    } else{
      display.setTextColor(BLACK);
    }
    display.print("_");
    display.display();
    delay(500);
  }

  display.setCursor(6, 8*4);
  display.setTextColor(WHITE);
  display.print(" enjoy ");
  display.write(0x03);;
  display.display();
  delay(700);
  
  for(byte i = 0; i<96; i++){
    display.clearDisplay();
    display.setTextSize(1); // set text size to 2
    display.setTextColor(WHITE); // set text color to white
    display.setCursor(35, 18); // set cursor position
    display.println("loading..."); // print text
    display.drawRect(14, 30, 100, 14, WHITE);
    display.fillRect(16, 32, i, 10, WHITE);
    display.display();
  }
}

static const unsigned char PROGMEM bitmap[] = {

0x40, 0x00, 0x00, 0x00, 0x00, 0x00, 0x00, 0x00, 0x00, 0x00, 0x00, 0x00, 0x00, 0x00, 0x00, 0x02, 
  0xe1, 0x00, 0x00, 0x00, 0x00, 0x00, 0x00, 0x00, 0x00, 0x00, 0x00, 0x00, 0x00, 0x00, 0x01, 0x07, 
  0x48, 0x00, 0x00, 0x00, 0x00, 0x00, 0x00, 0x00, 0x00, 0x00, 0x00, 0x00, 0x00, 0x00, 0x00, 0x12, 
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  0x00, 0x00, 0x00, 0x00, 0x00, 0x00, 0x00, 0x00, 0x00, 0x00, 0x00, 0x00, 0x00, 0x00, 0x00, 0x28
};

void drawBitmap(){
  display.clearDisplay();
  display.drawBitmap(0, 0, bitmap, 128, 64, 1);
  display.display();
}


void scoreCount(){
  //for player 2
  if(x - 2 < 5 && y < p1_pallet_y - 2){
    p2_score++;
    x = 64;
    y = 32;
  }
  if(x - 2 < 5 && y > p1_pallet_y + 14){
    p2_score++;
    x = 64;
    y = 32;
  }
  //for player 1
  if(x + 2 > 123 && y < p2_pallet_y - 2){
    p1_score++;
    x = 64;
    y = 32;
  }
  if(x + 2 > 123 && y > p2_pallet_y + 14){
    p1_score++;
    x = 64;
    y = 32;
  }
}

void reset_score(){
  p1_score = 0;
  p2_score = 0;
}
 
void game(){
   //ball bounce
  if((millis() - delai) > ball_delay){
   
    if(x+2 > 123 || x-2 < 5){
      bx *= -1;
    }
    if(y+2 > 61 || y-2 < 3){
      by *= -1;
    }
    x += bx;
    y += by;
    delai = millis();
  }
  // end ball bounce
  
  // begin control pallets
  if(b1 == 1 && p1_pallet_y -1 > 2 ){
    p1_pallet_y -= 1;
  }
  if(b2 == 1 && p1_pallet_y+10 < 63 ){
    p1_pallet_y += 1; 
  }

  
  // if 1 player mode
    if(x == 66){needRand = 1;} else{needRand = 0;}
    if(x > 64 ){
      if(needRand == 1){goal = random(0, dif);}
      if(goal == 2){
        p2_pallet_y = y - 15;
      }
      else{
        p2_pallet_y = y - 5;
      }
    }
  
  // end control pallets
  
  
  if(p1_score != p1_score1 || p2_score != p2_score2){
    yscore = 15;
    xscore1 = 30;
    xscore2 = 78;
    
    for(byte i = 0; i<80; i++){
      display.clearDisplay();
      display.setTextSize(4); 
      display.setTextColor(WHITE);  
      display.setCursor(xscore1, yscore);
      display.print(p1_score);
      display.setCursor(xscore2, yscore);
      display.print(p2_score);
      display.drawLine(64, 0, 64, 64, WHITE);
      display.fillRect(0, 55, 128, 55, WHITE);
      if(i > 77){
        yscore = 100;
        xscore1 = 150;
        xscore2 = 150;
      }
      display.display();
      delay(score_dsp_delay);
    }
      display.clearDisplay();
      
      p1_score1 = p1_score;
      p2_score2 = p2_score;
      x = 64;
      y = 32;
  }
  scoreCount();    
  if(p1_score == p1_score1 && p2_score == p2_score2){
    display.clearDisplay();  
    display.drawCircle(x, y, 4, WHITE);
    display.drawLine(64, 0, 64, 64, WHITE);
    display.drawLine(2, p1_pallet_y, 2, p1_pallet_y+10, WHITE);
    display.drawLine(126, p2_pallet_y, 126, p2_pallet_y+10, WHITE);
    display.display();
  }
  
}


class menu {
  public:
    menu(String caption, String item1, String item2, String item3, String item4, byte minn, byte maxx);
    void play();
    

  private:
   String cap;
   String it1;
   String it2;
   String it3;
   String it4;
   byte _min;
   byte _max;
};
menu::menu(String caption, String item1, String item2, String item3, String item4, byte minn, byte maxx){
  cap = caption;
  it1 = item1;
  it2 = item2;
  it3 = item3;
  it4 = item4;
  _min = minn;
  _max = maxx;
  
  }

void menu::play(){
  if(b1 == 1 && (millis() - sec) > menu_delay){
    selY -= 10;
    sec = millis();
  }

  if(selY < _min){
    selY = _max;
  }
  
  display.clearDisplay();
  display.setTextSize(1); 
  display.setTextColor(WHITE); 
  display.setCursor(50, 0);  
  display.print(cap);
  display.drawLine(0, 9, 128, 9, WHITE);
  display.setCursor(6, 13);  
  display.print(it1);
  display.setCursor(6, 23);  
  display.print(it2);
  display.setCursor(6, 33);  
  display.print(it3);
  display.setCursor(6, 43);  
  display.print(it4);
  display.drawRoundRect(1, selY, 122, 11, 4, WHITE);
  display.display();
  
}

menu game_menu("main", "pong", "stopwatch...", "game 3", "settings", 12, 42);
    menu level_menu("level", "easy", "hard", "impossible", " ", 12, 32);
  menu settings_menu("settings", "sound", "credits", " ", " ", 12, 22);
    menu sound_menu("sound", "on", "off", " ", " ", 12, 22);


 


void setup() {
  Wire.begin();
  display.begin(SSD1306_SWITCHCAPVCC, 0x3C);
  display.clearDisplay();
  display.display();
  pinMode(LED_BUILTIN, OUTPUT);
  pinMode(13, INPUT_PULLUP); // b1
  pinMode(0, INPUT_PULLUP); //  b2

  digitalWrite(2, 0);
  randomSeed(analogRead(A0));
  load();
}

void loop() {
  b1 = !digitalRead(13);
  b2 = !digitalRead(0);
  
  // if u are in main game menu
  if(location == 0/*game menu*/){ 
    game_menu.play();
    if(b2 == 1 && selY == 42 && millis() - sec > menu_delay){location = 1/*settings*/; selY = 12; sec = millis();}
    if(b2 == 1 && selY == 12 && millis() - sec > menu_delay){location = 2/*pong*/;     selY = 12; sec = millis();}
    if(b2 == 1 && selY == 22 && millis() - sec > menu_delay){location = 3/*pong*/;     selY = 12; sec = millis();}
  }
  // if u are in pong menu
  if(location == 2/*pong*/){
    level_menu.play();
    if(b2 == 1 && selY == 12 && millis() - sec > menu_delay){location = 5; selY = 12; sec = millis();   dif = 4;  reset_score();}
    if(b2 == 1 && selY == 22 && millis() - sec > menu_delay){location = 5; selY = 12; sec = millis();   dif = 8;  reset_score();}
    if(b2 == 1 && selY == 32 && millis() - sec > menu_delay){location = 5; selY = 12; sec = millis();   dif = 16; reset_score();}
  }

  if(location == 3){
    //dispStopwatch();
  }

  if(location == 5){
    game();
  }
  
  // if u are in settings
  if(location == 1/*settings  */){
    settings_menu.play();
    if(b2 == 1 && selY == 12 && millis() - sec > menu_delay){location = 6/*"sound"*/;   selY = 12; sec = millis();}
    if(b2 == 1 && selY == 22 && millis() - sec > menu_delay){location = 7/*"credits"*/; selY = 12; sec = millis();}
  }
// if u are in sound on/off menu
  if(location == 6/*sound*/){
    sound_menu.play();
    if(b2 == 1 && selY == 12 && millis() - sec > menu_delay){sound = 1;}
    if(b2 == 1 && selY == 22 && millis() - sec > menu_delay){sound = 0;}
  }
  
  if(location == 7/*settings  */){
    drawBitmap();
  }
  
// get u back to main game menu
  if( b1 == 1 && b2 == 1){
    selY = 12;
    location = 0;
  }
  
}
